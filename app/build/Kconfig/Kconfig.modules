## app/build/Kconfig/Kconfig.modules
```kconfig
menu "eie_nrf52840 (/Users/user/zephyr-projects/eie_nrf52840)"
osource "/Users/user/zephyr-projects/eie_nrf52840/Kconfig"
config ZEPHYR_EIE_NRF52840_MODULE
	bool
	default y
endmenu
menu "cmsis_6 (/Users/user/zephyr-projects/modules/hal/cmsis_6)"
osource "$(ZEPHYR_CMSIS_6_KCONFIG)"
config ZEPHYR_CMSIS_6_MODULE
	bool
	default y
endmenu
menu "hal_nordic (/Users/user/zephyr-projects/modules/hal/nordic)"
osource "$(ZEPHYR_HAL_NORDIC_KCONFIG)"
config ZEPHYR_HAL_NORDIC_MODULE
	bool
	default y

config ZEPHYR_HAL_NORDIC_MODULE_BLOBS
	bool
endmenu
```
